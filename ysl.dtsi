#include "soc.dtsi"
#include "sdhc.dtsi"
#include "spi.dtsi"
#include "pinctrl.dtsi"
#include "ysl-pinctrl.dtsi"
#include "android.dtsi"
#include "haptic.dtsi"
#include "misc.dtsi"
#include "battery.dtsi"
#include "display.dtsi"
#include "fingerprint.dtsi"
#include "power.dtsi"
#include "touchscreen.dtsi"